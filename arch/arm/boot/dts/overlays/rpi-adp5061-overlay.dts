/dts-v1/;
/plugin/;

/ {
	compatible = "brcm,bcm2708";

	fragment@0 {
		target = <&i2c1>;
		__overlay__ {
			#address-cells = <1>;
			#size-cells = <0>;
			status = "okay";

			adp5061@28 {
				compatible = "adi,adp5061";
				reg = <0x28>;
			};
		};
	};
};
